/**
 * @file test_simulation.c
 * @brief Test program for hardware simulation interface
 * @details Demonstrates C code using Python simulation backend
 *
 * This test program shows how C drivers can use the simulation
 * framework for safe development and testing.
 *
 * @note Part of STM32H753ZI stepper motor control project
 * @author Generated by Phase 1B simulation framework
 * @date 2025
 */

#include "simulation/hardware_simulation.h"
#include <assert.h>
#include <stdint.h>
#include <stdio.h>

/* Test function prototypes */
static void test_l6470_basic_operations(void);
static void test_as5600_basic_operations(void);
static void test_simulation_control(void);
static void print_test_result(const char *test_name, bool passed);

/**
 * @brief Main test function
 */
int main(void) {
    printf("Hardware Simulation Test Program\n");
    printf("================================\n\n");

    /* Initialize simulation */
    simulation_error_t result = simulation_init(
        "schemas/l6470_registers.yaml", "schemas/as5600_registers.yaml");

    if (result != SIM_OK) {
        printf("ERROR: Failed to initialize simulation (error code: %d)\n",
               result);
        printf(
            "Make sure schema files exist and Python environment is set up\n");
        return 1;
    }

    printf("✅ Simulation initialized successfully\n\n");

    /* Run test suites */
    test_l6470_basic_operations();
    test_as5600_basic_operations();
    test_simulation_control();

    /* Cleanup */
    simulation_cleanup();

    printf("\n✅ All tests completed!\n");
    printf("The simulation framework is ready for driver integration.\n");

    return 0;
}

/**
 * @brief Test L6470 basic register operations
 */
static void test_l6470_basic_operations(void) {
    printf("Testing L6470 Basic Operations\n");
    printf("------------------------------\n");

    simulation_error_t result;
    uint32_t value;
    bool test_passed;

    /* Test 1: Read STATUS register (should be readable) */
    result = l6470_sim_read_register(0x19, &value);
    test_passed = (result == SIM_OK);
    print_test_result("L6470 Read STATUS register", test_passed);
    if (test_passed) {
        printf("   STATUS = 0x%04X\n", value);
    }

    /* Test 2: Write MAX_SPEED register */
    result = l6470_sim_write_register(0x07, 0x0200);
    test_passed = (result == SIM_OK);
    print_test_result("L6470 Write MAX_SPEED register", test_passed);

    /* Test 3: Read back MAX_SPEED register */
    result = l6470_sim_read_register(0x07, &value);
    test_passed = (result == SIM_OK && value == 0x0200);
    print_test_result("L6470 Read back MAX_SPEED register", test_passed);
    if (test_passed) {
        printf("   MAX_SPEED = 0x%04X\n", value);
    }

    /* Test 4: Send RUN command */
    result =
        l6470_sim_send_command(0x50, 0x0100); /* RUN forward at speed 0x0100 */
    test_passed = (result == SIM_OK);
    print_test_result("L6470 Send RUN command", test_passed);

    /* Test 5: Send SOFT_STOP command */
    result = l6470_sim_send_command(0xB0, 0x0000); /* SOFT_STOP */
    test_passed = (result == SIM_OK);
    print_test_result("L6470 Send SOFT_STOP command", test_passed);

    printf("\n");
}

/**
 * @brief Test AS5600 basic register operations
 */
static void test_as5600_basic_operations(void) {
    printf("Testing AS5600 Basic Operations\n");
    printf("-------------------------------\n");

    simulation_error_t result;
    uint16_t value;
    bool test_passed;

    /* Test 1: Read STATUS register */
    result = as5600_sim_read_register(0x0B, &value);
    test_passed = (result == SIM_OK);
    print_test_result("AS5600 Read STATUS register", test_passed);
    if (test_passed) {
        printf("   STATUS = 0x%02X\n", value);
    }

    /* Test 2: Read ANGLE_H register */
    result = as5600_sim_read_register(0x0E, &value);
    test_passed = (result == SIM_OK);
    print_test_result("AS5600 Read ANGLE_H register", test_passed);
    if (test_passed) {
        printf("   ANGLE_H = 0x%02X\n", value);
    }

    /* Test 3: Read ANGLE_L register */
    result = as5600_sim_read_register(0x0F, &value);
    test_passed = (result == SIM_OK);
    print_test_result("AS5600 Read ANGLE_L register", test_passed);
    if (test_passed) {
        printf("   ANGLE_L = 0x%02X\n", value);
    }

    /* Test 4: Calculate combined angle */
    uint16_t angle_h, angle_l;
    result = as5600_sim_read_register(0x0E, &angle_h);
    if (result == SIM_OK) {
        result = as5600_sim_read_register(0x0F, &angle_l);
        if (result == SIM_OK) {
            uint16_t angle_raw = ((angle_h & 0x0F) << 8) | angle_l;
            float angle_degrees = (angle_raw / 4096.0f) * 360.0f;
            printf("   Combined angle: %d counts = %.1f degrees\n", angle_raw,
                   angle_degrees);
            test_passed = true;
        } else {
            test_passed = false;
        }
    } else {
        test_passed = false;
    }
    print_test_result("AS5600 Calculate combined angle", test_passed);

    /* Test 5: Read AGC register */
    result = as5600_sim_read_register(0x1A, &value);
    test_passed = (result == SIM_OK);
    print_test_result("AS5600 Read AGC register", test_passed);
    if (test_passed) {
        printf("   AGC = 0x%02X\n", value);
    }

    printf("\n");
}

/**
 * @brief Test simulation control functions
 */
static void test_simulation_control(void) {
    printf("Testing Simulation Control\n");
    printf("--------------------------\n");

    simulation_error_t result;
    simulation_status_t status;
    bool test_passed;

    /* Test 1: Get simulation status */
    result = simulation_get_status(&status);
    test_passed = (result == SIM_OK);
    print_test_result("Get simulation status", test_passed);
    if (test_passed) {
        printf("   Motor position: %d steps\n", status.motor_position);
        printf("   Motor speed: %.1f steps/sec\n", status.motor_speed);
        printf("   Encoder angle: %.1f degrees\n", status.encoder_angle);
        printf("   Linked motion: %s\n",
               status.linked_motion ? "enabled" : "disabled");
        printf("   Physics active: %s\n",
               status.physics_active ? "yes" : "no");
    }

    /* Test 2: Enable linked motion */
    result = simulation_enable_linked_motion(200);
    test_passed = (result == SIM_OK);
    print_test_result("Enable linked motion", test_passed);

    /* Test 3: Disable linked motion */
    result = simulation_disable_linked_motion();
    test_passed = (result == SIM_OK);
    print_test_result("Disable linked motion", test_passed);

    /* Test 4: Start physics simulation */
    result = simulation_start_physics();
    test_passed = (result == SIM_OK);
    print_test_result("Start physics simulation", test_passed);

    /* Test 5: Stop physics simulation */
    result = simulation_stop_physics();
    test_passed = (result == SIM_OK);
    print_test_result("Stop physics simulation", test_passed);

    /* Test 6: Set AS5600 angle pattern */
    result = as5600_sim_set_pattern("rotating", 30.0f);
    test_passed = (result == SIM_OK);
    print_test_result("Set AS5600 angle pattern", test_passed);

    /* Test 7: Set AS5600 specific angle */
    result = as5600_sim_set_angle(90.0f);
    test_passed = (result == SIM_OK);
    print_test_result("Set AS5600 specific angle", test_passed);

    printf("\n");
}

/**
 * @brief Print test result
 */
static void print_test_result(const char *test_name, bool passed) {
    printf("   %s %s\n", passed ? "✅" : "❌", test_name);
}
